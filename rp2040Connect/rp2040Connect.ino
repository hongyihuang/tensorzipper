const size_t DATA_SIZE = sizeof(data)/sizeof(uint8_t);

const uint8_t data_zip[] = {
  0x0, 0x4, 0x60, 0x6c, 0x4a, 0xf6, 0xd4, 0x37, 0xd2, 0xdd, 0xf4, 0x45,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 0x6
};
const uint8_t data_zip_dist[] = {0xc2, 0x5, 0x4, 0x4, 0x4, 0x4, 0x4, 0x4, 0x4, 0x4, 0x3, 0x4, 0x4, 0x5, 0x4, 0x5};
const size_t DATA_ZIP_SIZE = sizeof(data_zip)/sizeof(uint8_t);

void printByte(uint8_t x) {
  if (x < 4) {
    Serial.print("  ");
  } else if (x < 8) {
    Serial.print("..");
  } else if (x < 12) {
    Serial.print("**");
  } else if (x < 16) {
    Serial.print("%%");
  } else {
    Serial.print("??");
  }
}

void printMNIST(const uint8_t* arr) {
  for (size_t i = 0; i < DATA_SIZE; i++) {
    uint8_t x = *(arr+i);
    printByte(x);
    if ((i % 14) == 0) {
      Serial.println();
    }
  }
}

void printZip(const uint8_t* bitstream, const uint8_t* dist, const size_t size) {
  uint8_t cumulative[16], inv_f[256];

  cumulative[0] = 0;
  for (int k = 1; k < 16; k++) {
    cumulative[k] = cumulative[k-1] + dist[k-1];
  }
  
  int y = 0;
  for (int x = 0; x < 256; x++) {
    if ((x < cumulative[y]) || (y >= 16)) {
      inv_f[x] = y-1;
    } else {
      y += 1;
      inv_f[x] = y-1;
    }
  }
  
  uint32_t state = (bitstream[0] << 16) + (bitstream[1] << 8) + bitstream[2];
  uint8_t symbol, slot;
  // i: counter of compressed data block
  // j: counter of decompressed data block
  size_t i = 0;
  size_t j = 3;
  
  while ((j < size) || (state != 256)) {
    // perform decoding
    slot = state & 0xFF;
    symbol = inv_f[slot];
    state = (state >> 8) * dist[symbol] + slot - cumulative[symbol];
    
    // remap state
    while ((j < size) && (state < 256)) {
      state = (state << 8) + bitstream[j++];
    }

    printByte(symbol);
    if ((i % 14) == 0) {
      Serial.println();
    }
    
    if ((i % (14*14)) == 0) {
      delay(5000);
      Serial.println("============================");
    }
    
    i += 1;
  }
}

void setup() {
  // put your setup code here, to run once:
  // initialize digital pin LED_BUILTIN as an output.
  pinMode(LED_BUILTIN, OUTPUT);
  Serial.begin(9600);
  delay(1000);
}

void loop() {
  // put your main code here, to run repeatedly:
  digitalWrite(LED_BUILTIN, HIGH);  // turn the LED on (HIGH is the voltage level)
  delay(200);                      // wait for a second
  digitalWrite(LED_BUILTIN, LOW);   // turn the LED off by making the voltage LOW
  delay(800);                      // wait for a second
  //printMNIST(data);
  printZip(data_zip, data_zip_dist, DATA_ZIP_SIZE);
  delay(10000);
}
